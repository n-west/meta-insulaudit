## conf/distro/insulaudit.conf
```bitbake
#@--------------------------------------------------------------------
#@TYPE: Distribution
#@NAME: Insulaudit
#@DESCRIPTION: A Linux Distribution for medical device auditing
#@MAINTAINER: Nathan West
#@MAINTAINER: Ben West
#@--------------------------------------------------------------------
MEDEVICE_URI = "http://commlabbuild.ceat.okstate.edu/"

DISTRO_VERSION = "v2014.01.01"
DISTRO_FEATURES = "systemd"
MAINTAINER = "Nathan West <nate.ewest@gmail.com>"

# Inherit the default LIBC features superset from OE-core
DISTRO_FEATURES += "${DISTRO_FEATURES_LIBC}"

# Disable sysvinit for recipes with systemd support
DISTRO_FEATURES_BACKFILL_CONSIDERED += "sysvinit"
VIRTUAL-RUNTIME_init_manager = "systemd"

# Uncomment to completely disable support for sysv scripts:
#PACKAGECONFIG_pn-systemd = "xz"
#Images built can have to modes:
# 'debug': empty rootpassword, strace included
# 'release' no root password, no strace and gdb by default
DISTRO_TYPE ?= "debug"
#DISTRO_TYPE = "release"

PACKAGECONFIG_pn-libpcap = ""
#
# udev, devfsd, busybox-mdev (from busybox) or none
#
IMAGE_DEV_MANAGER ?= "udev"
VIRTUAL-RUNTIME_dev_manager ?= "udev"
#
# sysvinit, upstart, systemd
#
IMAGE_INIT_MANAGER ?= "systemd"
IMAGE_INITSCRIPTS ?= "systemd-compat-units"
#
# busybox, getty
#
IMAGE_LOGIN_MANAGER ?= "busybox"
VIRTUAL-RUNTIME_login_manager ?= "busybox"

EXTRA_IMAGE_FEATURES ?= "package-management"
```
